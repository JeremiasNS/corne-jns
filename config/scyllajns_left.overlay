/*
 * Copyright (c) 2020 The ZMK Contributors
 * SPDX-License-Identifier: MIT
 *
 * ScyllaJNS — lado esquerdo
 * Colunas C0–C5, col2row: saídas sem pull
 */

#include "corne.dtsi"

&kscan0 {
    row-gpios
        = <&gpio1 13 (GPIO_ACTIVE_HIGH | GPIO_PULL_DOWN)>  /* 113 */
        , <&gpio1 11 (GPIO_ACTIVE_HIGH | GPIO_PULL_DOWN)>  /* 111 */
        , <&gpio0 10 (GPIO_ACTIVE_HIGH | GPIO_PULL_DOWN)>  /* 010 */
        , <&gpio0 9  (GPIO_ACTIVE_HIGH | GPIO_PULL_DOWN)>  /* 009 */
        ;
    col-gpios
        = <&gpio0 22 GPIO_ACTIVE_HIGH>  /* 022 */
        , <&gpio0 24 GPIO_ACTIVE_HIGH>  /* 024 */
        , <&gpio1 0  GPIO_ACTIVE_HIGH>  /* 100 */
        , <&gpio0 11 GPIO_ACTIVE_HIGH>  /* 011 */
        , <&gpio1 4  GPIO_ACTIVE_HIGH>  /* 104 */
        , <&gpio1 6  GPIO_ACTIVE_HIGH>  /* 106 */
        ;
};