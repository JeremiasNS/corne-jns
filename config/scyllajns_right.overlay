/*
 * Copyright (c) 2020 The ZMK Contributors
 * SPDX-License-Identifier: MIT
 *
 * ScyllaJNS — lado direito
 * Mesmos pinos físicos da esquerda, col-offset = 6 mapeia para C6–C11
 */

#include "corne.dtsi"

&default_transform {
    col-offset = <6>;
};

&kscan0 {
    row-gpios
        = <&gpio1 0  (GPIO_ACTIVE_HIGH | GPIO_PULL_DOWN)>  /* 100 */
        , <&gpio0 11 (GPIO_ACTIVE_HIGH | GPIO_PULL_DOWN)>  /* 011 */
        , <&gpio1 4  (GPIO_ACTIVE_HIGH | GPIO_PULL_DOWN)>  /* 104 */
        , <&gpio1 6  (GPIO_ACTIVE_HIGH | GPIO_PULL_DOWN)>  /* 106 */
        ;
    col-gpios
        = <&gpio0 9  GPIO_ACTIVE_HIGH>  /* 009 */
        , <&gpio0 10 GPIO_ACTIVE_HIGH>  /* 010 */
        , <&gpio1 11 GPIO_ACTIVE_HIGH>  /* 111 */
        , <&gpio1 13 GPIO_ACTIVE_HIGH>  /* 113 */
        , <&gpio1 15 GPIO_ACTIVE_HIGH>  /* 115 */
        , <&gpio0 2  GPIO_ACTIVE_HIGH>  /* 002 */
        ;
};