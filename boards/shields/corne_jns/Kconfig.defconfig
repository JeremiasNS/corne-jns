## boards/shields/corne_jns/Kconfig.defconfig
```kconfig
if SHIELD_CORNE_JNS_LEFT

config ZMK_KEYBOARD_NAME
    default "Corne JNS"

config ZMK_SPLIT_ROLE_CENTRAL
    default y

endif

if SHIELD_CORNE_JNS_LEFT || SHIELD_CORNE_JNS_RIGHT

config ZMK_SPLIT
    default y

endif
```

## boards/shields/corne_jns/Kconfig.shield
```kconfig
config SHIELD_CORNE_JNS_LEFT
    def_bool $(shields_list_contains,corne_jns_left)

config SHIELD_CORNE_JNS_RIGHT
    def_bool $(shields_list_contains,corne_jns_right)
```
