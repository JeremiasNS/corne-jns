/*
 * Corne JNS — lado direito (periférico)
 * col-offset = 6 -> col6..col11 = dentro -> fora
 */

#include "corne_jns.dtsi"

&default_transform {
    col-offset = <6>;
};

&kscan0 {
    row-gpios
        = <&gpio1 0  (GPIO_ACTIVE_HIGH | GPIO_PULL_DOWN)>  /* 100 */
        , <&gpio0 11 (GPIO_ACTIVE_HIGH | GPIO_PULL_DOWN)>  /* 011 */
        , <&gpio1 4  (GPIO_ACTIVE_HIGH | GPIO_PULL_DOWN)>  /* 104 */
        , <&gpio1 6  (GPIO_ACTIVE_HIGH | GPIO_PULL_DOWN)>  /* 106 */
        ;
    col-gpios
        = <&gpio0 9  GPIO_ACTIVE_HIGH>  /* 009 */
        , <&gpio0 10 GPIO_ACTIVE_HIGH>  /* 010 */
        , <&gpio1 11 GPIO_ACTIVE_HIGH>  /* 111 */
        , <&gpio1 13 GPIO_ACTIVE_HIGH>  /* 113 */
        , <&gpio1 15 GPIO_ACTIVE_HIGH>  /* 115 */
        , <&gpio0 2  GPIO_ACTIVE_HIGH>  /* 002 */
        ;
};
